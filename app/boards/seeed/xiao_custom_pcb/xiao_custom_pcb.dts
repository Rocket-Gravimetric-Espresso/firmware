/*
 * Copyright (c) 2022-2023 Marcin Niestroj
 *
 * SPDX-License-Identifier: Apache-2.0
 */

/dts-v1/;
#include "xiao_custom_pcb_common.dtsi"

/ {
	model = "Seeed XIAO Custom PCB";
	compatible = "seeed,xiao-ble";
};
